#include "sh1106.h"
// tinyAVR 2-series maps flash into data space, so const tables stay in flash
// and are read directly (no PROGMEM / pgm_read_byte needed).

// 5x7 font, ASCII 0x20..0x5A (space..Z); lowercase is folded to upper case.
static const uint8_t font5x7[] = {
  0,0,0,0,0, 0,0,0x5F,0,0, 0,7,0,7,0, 0x14,0x7F,0x14,0x7F,0x14,
  0x24,0x2A,0x7F,0x2A,0x12, 0x23,0x13,8,0x64,0x62, 0x36,0x49,0x55,0x22,0x50, 0,5,3,0,0,
  0,0x1C,0x22,0x41,0, 0,0x41,0x22,0x1C,0, 8,0x2A,0x1C,0x2A,8, 8,8,0x3E,8,8,
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  0x63,0x14,8,0x14,0x63, 3,4,0x78,4,3, 0x61,0x51,0x49,0x45,0x43
};

// 8x16 digits 0-9; each glyph is 8 bytes top page then 8 bytes bottom page.
// '0' is an open oval with the same 2 px stroke as 6/8/9. A slashed zero
// merged the slash into that stroke and read heavier than the other digits.
static const uint8_t font8x16[10][16] = {
  {0xF8,0xFC,0x06,0x02,0x06,0xFC,0xF8,0x00, 0x1F,0x3F,0x60,0x40,0x60,0x3F,0x1F,0x00},
  {0x00,0x08,0x0C,0xFE,0xFE,0x00,0x00,0x00, 0x00,0x40,0x40,0x7F,0x7F,0x40,0x40,0x00},
  {0x18,0x1C,0x06,0x02,0x82,0xFC,0x78,0x00, 0x60,0x70,0x58,0x4C,0x46,0x43,0x40,0x00},
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  {0x78,0xFC,0x86,0x02,0x86,0xFC,0xF8,0x00, 0x00,0x41,0x43,0x62,0x31,0x1F,0x0F,0x00},
};

static const uint8_t init_seq[] = {
  0xAE,       // display off
  0xD5, 0x80, // clock divide
  0xA8, 0x3F, // multiplex 64
  0xD3, 0x00, // display offset
  0x40,       // start line 0
  0xAD, 0x8B, // DC-DC on
  0xA1,       // segment remap
  0xC8,       // COM scan reversed
  0xDA, 0x12, // COM pins
  0x81, 0x80, // contrast
  0xD9, 0x22, // precharge
  0xDB, 0x35, // VCOM deselect
  0xA4, 0xA6, // resume RAM, normal (not inverted)
  0xAF        // display on
};

static const SPISettings spi_cfg(4000000, MSBFIRST, SPI_MODE0);

static void cmd(uint8_t c) {
  digitalWrite(OLED_DC, LOW);
  digitalWrite(OLED_CS, LOW);
  SPI.transfer(c);
  digitalWrite(OLED_CS, HIGH);
}

static void data(const uint8_t *p, uint8_t n) {
  digitalWrite(OLED_DC, HIGH);
  digitalWrite(OLED_CS, LOW);
  while (n--) SPI.transfer(*p++);
  digitalWrite(OLED_CS, HIGH);
}

namespace sh1106 {

void begin() {
  pinMode(OLED_CS, OUTPUT);
  pinMode(OLED_DC, OUTPUT);
  pinMode(OLED_RES, OUTPUT);
  digitalWrite(OLED_CS, HIGH);
  SPI.begin();
  SPI.beginTransaction(spi_cfg);
  digitalWrite(OLED_RES, LOW);   // hold reset >= 5 us (datasheet), 20 us used
  delayMicroseconds(20);
  digitalWrite(OLED_RES, HIGH);
  delay(2);
  for (uint8_t i = 0; i < sizeof(init_seq); i++) cmd(init_seq[i]);
  clear();
}

void setPos(uint8_t page, uint8_t col) {
  col += SH1106_COL_OFFSET;
  cmd(0xB0 | (page & 7));
  cmd(0x00 | (col & 0x0F));
  cmd(0x10 | (col >> 4));
}

void clear() {
  for (uint8_t p = 0; p < 8; p++) fill(p, 0, 128, 0);
}

static const uint8_t *glyph5(char ch) {
  if (ch >= 'a' && ch <= 'z') ch -= 32;
  if (ch < ' ' || ch > 'Z') ch = ' ';
  return &font5x7[(ch - ' ') * 5];
}

void text5x7(uint8_t page, uint8_t col, const char *s, uint8_t ul, bool inv) {
  setPos(page, col);
  digitalWrite(OLED_DC, HIGH);
  digitalWrite(OLED_CS, LOW);
  for (uint8_t i = 0; s[i]; i++) {
    const uint8_t *g = glyph5(s[i]);
    uint8_t extra = (i == ul) ? 0x80 : 0;  // underline row
    for (uint8_t k = 0; k < 6; k++) {
      uint8_t v = (k < 5 ? *(g + k) : 0) | extra;
      // Leave the bottom pixel clear when inverted. A full-page bar has no
      // gap before the next page, so the highlight touches the line below.
      if (inv) v = (uint8_t)((~v) & 0x7F);
      SPI.transfer(v);
    }
  }
  digitalWrite(OLED_CS, HIGH);
}

void paint5x7(uint8_t *dst, uint8_t page, uint8_t y, uint8_t col, const char *s, bool inv) {
  uint8_t top = page * 8;
  if (inv) {
    // 9 px bar: one pixel above the glyph and one below, so ink does not sit
    // on the highlight edge. Rows outside this page, or off the panel, skip.
    for (int8_t b = -1; b <= 7; b++) {
      int16_t yy = (int16_t)y + b;
      if (yy < 0 || yy > 63 || yy < top || yy >= top + 8) continue;
      uint8_t bit = 1 << (uint8_t)(yy - top);
      for (uint8_t x = 0; x < 128; x++) dst[x] |= bit;
    }
  }
  for (uint8_t i = 0; s[i]; i++) {
    uint8_t x0 = col + i * 6;
    if (x0 >= 128) break;
    const uint8_t *g = glyph5(s[i]);
    for (uint8_t k = 0; k < 5 && x0 + k < 128; k++) {
      uint8_t bits = g[k];
      for (uint8_t b = 0; b < 7; b++) {
        if (!(bits & (1 << b))) continue;
        uint8_t yy = y + b;
        if (yy < top || yy >= top + 8) continue;
        uint8_t bit = 1 << (yy - top);
        if (inv) dst[x0 + k] &= (uint8_t)~bit;  // punch the glyph out of the bar
        else dst[x0 + k] |= bit;
      }
    }
  }
}

void writePage(uint8_t page, const uint8_t *bytes) {
  setPos(page, 0);
  data(bytes, 128);
}

void fill(uint8_t page, uint8_t col, uint8_t n, uint8_t b) {
  if (col + n > 128) n = 128 - col;
  setPos(page, col);
  digitalWrite(OLED_DC, HIGH);
  digitalWrite(OLED_CS, LOW);
  while (n--) SPI.transfer(b);
  digitalWrite(OLED_CS, HIGH);
}

void big8x16(uint8_t page, uint8_t col, const char *s) {
  static const uint8_t blank[8] = {0};
  static const uint8_t dot[8] = {0, 0, 0x60, 0x60, 0, 0, 0, 0};
  static const uint8_t minus[8] = {0, 0x80, 0x80, 0x80, 0x80, 0x80, 0, 0};
  for (uint8_t half = 0; half < 2; half++) {
    setPos(page + half, col);
    for (const char *q = s; *q; q++) {
      if (*q >= '0' && *q <= '9') data(&font8x16[*q - '0'][half * 8], 8);
      else if (*q == '.' && half) data(dot, 8);
      else if (*q == '-' && !half) data(minus, 8);
      else data(blank, 8);
    }
  }
}

}  // namespace sh1106
